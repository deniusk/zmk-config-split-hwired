&kscan0 {
    diode-direction = "col2row";

    row-gpios = <
        &gpio0 10 GPIO_ACTIVE_HIGH
        &gpio1 11 GPIO_ACTIVE_HIGH
        &gpio1 13 GPIO_ACTIVE_HIGH
        &gpio1 15 GPIO_ACTIVE_HIGH
    >;

    col-gpios = <
        &gpio1 4 GPIO_ACTIVE_HIGH
        &gpio0 11 GPIO_ACTIVE_HIGH
        &gpio1 0 GPIO_ACTIVE_HIGH
        &gpio0 24 GPIO_ACTIVE_HIGH
        &gpio0 22 GPIO_ACTIVE_HIGH
        &gpio0 20 GPIO_ACTIVE_HIGH
    >;
};