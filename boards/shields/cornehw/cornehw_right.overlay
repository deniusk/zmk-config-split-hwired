&kscan0 {
    compatible = "zmk,kscan-gpio-matrix";
    diode-direction = "col2row";   // tu diodo va hacia las columnas

    // FILAS → los pines que escanean horizontalmente
    row-gpios = <
        &gpio0 10 GPIO_ACTIVE_HIGH
        &gpio1 11 GPIO_ACTIVE_HIGH
        &gpio1 13 GPIO_ACTIVE_HIGH
        &gpio1 15 GPIO_ACTIVE_HIGH
    >;

    // COLUMNAS → los pines que escanean verticalmente
    // reordenadas para que cada tecla coincida correctamente
    col-gpios = <
        &gpio1 4  GPIO_ACTIVE_HIGH
        &gpio0 11 GPIO_ACTIVE_HIGH
        &gpio1 0  GPIO_ACTIVE_HIGH
        &gpio0 24 GPIO_ACTIVE_HIGH
        &gpio0 22 GPIO_ACTIVE_HIGH
        &gpio0 20 GPIO_ACTIVE_HIGH
    >;
};